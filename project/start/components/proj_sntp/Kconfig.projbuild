## project/start/components/proj_sntp/Kconfig.projbuild
```kconfig
menu "Project SNTP Configuration"

    config PROJ_SNTP_SERVER_PRIMARY
        string "Primary NTP server (optional)"
        default ""
        help
            Primary NTP server hostname or IP - e.g. your router's LAN IP
            if it provides NTP service. Leave blank to skip and use only
            the backup server below.

    config PROJ_SNTP_SERVER_BACKUP
        string "Backup NTP server"
        default "pool.ntp.org"
        help
            Used as a fallback if the primary server is unreachable, or as
            the sole server if PROJ_SNTP_SERVER_PRIMARY is left blank.

endmenu
```

## start/components/proj_ds18b20/Kconfig.projbuild
```kconfig
menu "Project DS18B20 Configuration"

    config PROJ_DS18B20_GPIO
        int "DS18B20 1-Wire bus GPIO"
        default 4
        help
            GPIO connected to the DS18B20 data line. GPIO4 is commonly
            free on both ESP32 and ESP32-C3 boards, but - as with
            PROJ_BLINK_GPIO - check your specific board's pinout and
            strapping-pin list before relying on the default.

    config PROJ_DS18B20_MAX_DEVICES
        int "Maximum DS18B20 devices per bus"
        default 4
        help
            Upper bound on how many DS18B20 devices proj_ds18b20_init()
            will enumerate on a single bus.

endmenu
```

## start/components/proj_mqtt/Kconfig.projbuild
```kconfig
menu "Project MQTT Configuration"

    config PROJ_MQTT_BROKER_URI
        string "MQTT broker URI"
        default "mqtt://mqtt:1883"
        help
            Full broker URI including scheme and port, e.g. mqtt://mqtt:1883
            for the production broker (hostname "mqtt"), or
            mqtt://192.168.x.x:1883 for a test broker. Anonymous,
            unencrypted connection - intended for use only within a
            trusted, isolated IoT VLAN.

endmenu
```

## start/main/Kconfig.projbuild
```kconfig
menu "LED Configuration"

config BLINK_GPIO
    int "Blink GPIO number"
    default 2 if IDF_TARGET_ESP32
    default 8 if IDF_TARGET_ESP32C3
    help
        GPIO number for the onboard LED.

endmenu
```
